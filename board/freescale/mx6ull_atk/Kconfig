## board/freescale/mx6ull_atk/Kconfig
```kconfig
if TARGET_MX6ULL_14X14_EVK || TARGET_MX6ULL_9X9_EVK || TARGET_MX6ULL_ATK_MINI || TARGET_MX6ULL_ATK

config SYS_BOARD
	default "mx6ull_atk"

config SYS_VENDOR
	default "freescale"

config SYS_CONFIG_NAME
	default "mx6ull_atk"

config SYS_TEXT_BASE
	default 0x87800000
endif
```
