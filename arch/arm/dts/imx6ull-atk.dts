// SPDX-License-Identifier: (GPL-2.0 OR MIT)
//
// Copyright (C) 2016 Freescale Semiconductor, Inc.

/dts-v1/;

#include "imx6ull.dtsi"
#include "imx6ull-atk.dtsi"
#include "imx6ull-atk-uboot.dtsi"

/ {
	model = "i.MX6 ULL ATK Board";
	compatible = "fsl,imx6ull-atk-mini", "fsl,imx6ull-atk", "fsl,imx6ull";
};

&clks {
	assigned-clocks = <&clks IMX6UL_CLK_PLL3_PFD2>;
	assigned-clock-rates = <320000000>;
};
